## CMakeLists.txt
```
# SPDX-License-Identifier: Apache-2.0

cmake_minimum_required(VERSION 3.20.0)
find_package(Zephyr REQUIRED HINTS $ENV{ZEPHYR_BASE})
project(BaseNode)
target_include_directories(app PRIVATE ${CMAKE_CURRENT_SOURCE_DIR}/include)
target_sources(app PRIVATE ${CMAKE_CURRENT_SOURCE_DIR}/src/main.c ${CMAKE_CURRENT_SOURCE_DIR}/src/gatt_client.c
${CMAKE_CURRENT_SOURCE_DIR}/src/sub_settings.c)
```

## sample.yaml
```
sample:
  name: Task1 - Random Number Display

tests:
  sample.task1.random_display:
    tags:
      - rng
      - uart
      - printk
    filter: dt_enabled_alias_with_parent_compat()
    depends_on: uart
    harness: console
    harness_config:
      type: one_line
      regex: "Random Number: [0-9A-F]{8}"
    integration_platforms:
      - frdm_k64f
      - nrf52840dk_nrf52840

manifest:
  projects:
    - name: mcuboot
      path: modules/bootloader/mcuboot
      revision: v1.9.0
  self:
    path: .
```

## prj.conf
```kconfig
# BLE
CONFIG_BT=y
CONFIG_BT_PERIPHERAL=n
CONFIG_BT_CENTRAL=y
CONFIG_BT_SMP=y
CONFIG_BT_GATT_CLIENT=y



# Logs and debugging
CONFIG_LOG=y
CONFIG_LOG_MODE_DEFERRED=n
CONFIG_PRINTK=y
CONFIG_LOG_MODE_IMMEDIATE=y
CONFIG_LOG_BACKEND_UART=y

# Memory and buffers
CONFIG_MAIN_STACK_SIZE=4096
CONFIG_SYSTEM_WORKQUEUE_STACK_SIZE=2048

# Needed for M5Stack Core2 ESP32
CONFIG_BT_HCI=y

# CONFIG_ESP32_USE_UNSUPPORTED_REVISION=y

CONFIG_SETTINGS=y
# Enable Bluetooth settings integration
CONFIG_BT_SETTINGS=y
CONFIG_SETTINGS_NVS=y 

# Enable persistent storage using flash
CONFIG_STREAM_FLASH=y
CONFIG_FLASH=y
CONFIG_FLASH_MAP=y
CONFIG_NVS=y
CONFIG_MPU_ALLOW_FLASH_WRITE=y

# Enable system settings load at boot
#CONFIG_SETTINGS_LOAD_ON_BOOT=y

CONFIG_BT_SMP=y
#CONFIG_BT_BONDABLE=y


# Enable Identity tracking (for bonded device persistence)
#CONFIG_BT_PRIVACY=y
CONFIG_BT_ID_MAX=1

CONFIG_JSON_LIBRARY=y

CONFIG_SHELL_CMDS=y
CONFIG_SHELL=y
CONFIG_SHELL_HISTORY=y
CONFIG_SHELL_TAB=y
# CONFIG_STDOUT_CONSOLE=y
CONFIG_UART_CONSOLE=y
CONFIG_SERIAL=y

# Enable MCUboot
CONFIG_BOOTLOADER_MCUBOOT=y
CONFIG_IMG_MANAGER=y
CONFIG_MCUBOOT_IMG_MANAGER=y
CONFIG_MCUBOOT_UPDATE_FOOTER_SIZE=0x1000

CONFIG_BOOTLOADER_MCUBOOT=y
CONFIG_IMG_MANAGER=y  

# Enable application to be built for MCUboot (i.e., split image)
# CONFIG_ZCBOR=y
# CONFIG_MCUMGR=y
# Enable mcumgr commands
# CONFIG_MCUMGR_CMD_IMG_MGMT=y
# CONFIG_MCUMGR_CMD_OS_MGMT=y

# CONFIG_MCUMGR_SMP_UART=y
# CONFIG_MCUMGR_SMP_WORKQUEUE_STACK_SIZE=4096
```

## boards/m5stack_core2_procpu.overlay
```dts
&uart0 {
    status = "okay";
    current-speed = <2000000>;
};
```

## src/main.c
```c
#include <zephyr/shell/shell.h>
#include <zephyr/kernel.h>
#include <zephyr/sys/printk.h>
#include <zephyr/data/json.h>
#include <string.h>
#include "gatt_client.h"
#include "sub_settings.h"

struct json_data {
    int16_t angle;
    int16_t distance;
    int tracking_state;
};

static int start_turret(const struct shell* shell, size_t argc, char **argv) {

    if(argc > 1) {
        printk("%s\r\n","too many arguements");
        return 1;
    }

    //send new power state
    write_data_with_response(1,&power_info);
    return 0;
}

static int stop_turret(const struct shell* shell, size_t argc, char **argv) {
    if(argc > 1) {
        printk("%s\r\n","too many arguements");
        return 1;
    }

    //send new power state
    write_data_with_response(0,&power_info);
    return 0;
}

//use the json_data instead to keep distance and angle values
//no variable needed for tracking state given it is determined through not sending distance
static void send_json(struct json_data* data, struct json_obj_descr* descr, char* char_buffer) {
    //encode json
    printk("{\"angle\": %d, \"distance\": %d, \"tracking\": %d}\n",
       data->angle, data->distance, data->tracking_state);
    //json_obj_encode_buf(descr, 3, data, char_buffer, 128);
    //printk("%s\r\n",char_buffer); //use this for now, otherwise try using usb cdc acm
    //send json
}

static void bt_ready(int err)
{
    if (err) {
        printk("Bluetooth init failed (err %d)\n", err);
        return;
    }

    printk("Bluetooth initialized\n");

    if (IS_ENABLED(CONFIG_SETTINGS)) {
		settings_load();
	}
    // Now safe to start scanning
    startup_scan();
}

//use thread, or use main to send received notifications for the angle and distance to dashboard
int main(void) {
    int err;

    //load service settings
    settings_load_subs();
    if(angle_info.handle == 0 || distance_info.handle == 0 || power_info.handle == 0) {
        printk("It is actually a problem %d\r\n", power_info.handle);
        settings_loaded = false;
    }

    printk("handle: %d\r\n",angle_info.handle);

    printk("Starting BLE Central Client\n");

    err = bt_enable(bt_ready);
    if (err) {
        printk("Bluetooth init failed (err %d)\n", err);
        return 1;
    }

    printk("Scanning started\n");
    
    char jsonFull[128];
    struct json_obj_descr descriptor[] = {
    JSON_OBJ_DESCR_PRIM_NAMED(struct json_data,"angle", angle, JSON_TOK_NUMBER),
    JSON_OBJ_DESCR_PRIM_NAMED(struct json_data,"distance", distance, JSON_TOK_NUMBER),
    JSON_OBJ_DESCR_PRIM_NAMED(struct json_data,"tracking",tracking_state, JSON_TOK_NUMBER)
    };

    int angleStatus = 0;
    int distanceStatus = 0;
    struct json_data data;

    //main loop //gets the angle_distance data + authorization(implied)+ tracking and sends it to the dashboard
    while(1) {

        //read if any value is available for 
        angleStatus = k_msgq_get(&angleQueue, &data.angle, K_FOREVER); 
        distanceStatus = k_msgq_get(&distanceQueue, &data.distance, K_NO_WAIT);

        //there is a location to track
        if(distanceStatus == 0) {
            data.tracking_state = 1;
        } else {
            data.distance = 0; //sweeping
            data.tracking_state = 0;
        }

        //json normally
        send_json(&data,descriptor,jsonFull);

        //call delay

        k_sleep(K_MSEC(50));

    }
}

SHELL_STATIC_SUBCMD_SET_CREATE(turret_commands,
        SHELL_CMD(start, NULL, "Add beacon nodes to array",start_turret),
        SHELL_CMD(stop, NULL, "Remove Beacon nodes from array",stop_turret),
        SHELL_SUBCMD_SET_END
);

SHELL_CMD_REGISTER(Turret, &turret_commands,  "Main command with subcommands for all action",NULL);
```

## include/gatt_client.h
```c
#include <zephyr/bluetooth/bluetooth.h>
#include <zephyr/bluetooth/conn.h>
#include <zephyr/bluetooth/gatt.h>
#include <zephyr/bluetooth/hci.h>
#include <zephyr/sys/printk.h>

#ifndef GATT_CLIENT_H
#define GATT_CLIENT_H

#pragma once

#define BT_UUID_CUSTOM_SERVICE_VAL \
    BT_UUID_128_ENCODE(0x12345678, 0x1234, 0x5678, 0x1234, 0x56789abcdef0)
#define BT_UUID_ANGLE_CHAR_VAL \
    BT_UUID_128_ENCODE(0xabcdabcd, 0xabcd, 0xabcd, 0xabcd, 0xabcdabcdef01)
#define BT_UUID_DISTANCE_CHAR_VAL \
    BT_UUID_128_ENCODE(0xdcbaabcd, 0xdcba, 0xdcba, 0xdcba, 0xdcbaabcdef02)
#define BT_UUID_POWER_STATE_VAL \
	BT_UUID_128_ENCODE(0x87654321, 0x4321, 0x8765, 0x4321, 0xabcdef123456)

struct service_info {
    char name[12];
    struct bt_gatt_subscribe_params params;
    uint16_t ccc_handle;
    uint16_t handle;
    bool subscribed;
    bool discovered;
};

extern struct service_info angle_info;
extern struct service_info distance_info;
extern struct service_info power_info;

extern struct k_msgq angleQueue;
extern struct k_msgq distanceQueue;

uint8_t startup_scan(void);
int write_data_with_response(uint8_t value, volatile struct service_info* info);

#endif // MY_CLIENT
```

## include/sub_settings.h
```c
#include <zephyr/bluetooth/bluetooth.h>
#include <zephyr/bluetooth/conn.h>
#include <zephyr/bluetooth/gatt.h>
#include <zephyr/bluetooth/hci.h>
#include <zephyr/sys/printk.h>

#ifndef SUB_SETTINGS_H
#define SUB_SETTINGS_H

//defines path and subfolders for settings
#define SETTINGS_SUB_PATH "subs"

struct service_info_store {
    uint16_t handle;
    uint16_t ccc_handle;
    bool subscribed;
}__packed;

void settings_load_subs(void);
int save_service_info(volatile struct service_info* info);

extern volatile bool settings_loaded;

#endif // MY_CLIENT
```

## src/gatt_client.c
```c
#include <zephyr/bluetooth/bluetooth.h>
#include <zephyr/bluetooth/conn.h>
#include <zephyr/bluetooth/gatt.h>
#include <zephyr/bluetooth/hci.h>
#include <zephyr/sys/printk.h>
#include <zephyr/data/json.h>
#include <stdbool.h>
#include <string.h>
#include "gatt_client.h"
#include "sub_settings.h"

static struct bt_uuid_128 uuid_service = BT_UUID_INIT_128(BT_UUID_CUSTOM_SERVICE_VAL);
static struct bt_uuid_128 uuid_angle = BT_UUID_INIT_128(BT_UUID_ANGLE_CHAR_VAL);
static struct bt_uuid_128 uuid_distance = BT_UUID_INIT_128(BT_UUID_DISTANCE_CHAR_VAL);
static struct bt_uuid_128 uuid_power = BT_UUID_INIT_128(BT_UUID_POWER_STATE_VAL);

static struct bt_conn *default_conn;
static uint16_t start_handle, end_handle;

static struct bt_gatt_discover_params discover_params;
static struct bt_gatt_discover_params character_params;
static struct bt_gatt_discover_params descriptor_params;
static uint8_t discover_func(struct bt_conn *conn,
                             const struct bt_gatt_attr *attr,
                             struct bt_gatt_discover_params *params);
uint8_t startup_scan(void);

K_MSGQ_DEFINE(angleQueue, sizeof(int16_t), 10, 8);
K_MSGQ_DEFINE(distanceQueue, sizeof(int16_t), 10, 8); //

//does not need mutex
struct service_info angle_info = {.name = "angle", .subscribed = false, .discovered = false};
struct service_info distance_info = {.name = "distance", .subscribed = false, .discovered = false};
struct service_info power_info = {.name = "power", .subscribed = false, .discovered = false};

//has to account for if connection is still referencable
// Callback when write completes
static void write_cb(struct bt_conn *conn, uint8_t err,
                     struct bt_gatt_write_params *params)
{
    if (err) {
        printk("Write failed (err 0x%02x)\n", err);
    } else {
        printk("Write successful\n");
    }
}

// Keep the write_params static to ensure it persists during the async call
static struct bt_gatt_write_params write_params;

int write_data_with_response(uint8_t value, volatile struct service_info* info)
{
    struct bt_conn *conn = bt_conn_ref(default_conn);
    if (!conn) {
        return -ENOTCONN;
    }

    if (!info->discovered) {
        bt_conn_unref(conn);
        return -1;
    }

    write_params.func = write_cb;
    write_params.handle = info->handle;
    write_params.offset = 0;
    write_params.data = &value;
    write_params.length = sizeof(value); // Now correctly 1 byte

    int err = bt_gatt_write(conn, &write_params);
    if (err) {
        printk("Failed to write %s (err %d)\n", info->name, err);
    } else {
        printk("%s value %u written to server (write with response)\n", info->name, value);
    }

    bt_conn_unref(conn);
    return err;
}

//should save to a global variable and a global flag, or a message queue(use this) to get notification values
//then use the message queues to json the shit and any additional porcessing(timestamp, alarm??)
static uint8_t notify_func(struct bt_conn *conn, struct bt_gatt_subscribe_params *params,
                           const void *data, uint16_t length)
{
    if (!data || length != sizeof(int16_t)) {
        printk("Notification stopped or invalid length\n");
        return BT_GATT_ITER_CONTINUE;
    }

    int16_t value;
    memcpy(&value, data, sizeof(value));

    if (params == &angle_info.params) {
        //printk("Angle: %d\n", value);
        k_msgq_put(&angleQueue,&value, K_NO_WAIT); //put received value in message queue to be processed in main

    } else if (params == &distance_info.params) {
        printk("Distance: %d\n", value);
        k_msgq_put(&distanceQueue,&value, K_NO_WAIT);

    }

    return BT_GATT_ITER_CONTINUE;
}

static void generic_sub_start(struct bt_conn *conn, struct service_info *info) {
    if(info->subscribed) {
        return;
    }

	if(info->handle && info->ccc_handle) {
		info->params.ccc_handle = info->ccc_handle;
		info->params.value_handle = info->handle;
        info->params.notify = notify_func;
        info->params.value = BT_GATT_CCC_NOTIFY;
	}

	 	int err = bt_gatt_subscribe(conn, &info->params);
        if (err) {
            printk("Failed to subscribe to %s (err %d)\n",info->name, err);
        } else {
            printk("Subscribed to %s notifications\n",info->name);
            info->subscribed = true;
            if(!settings_loaded) { //if not already saved, save it (for angle and distance only)
                save_service_info(info);
            }
        }
}

static void run_discovery(struct bt_gatt_discover_params* params,uint8_t type, uint16_t start, uint16_t end, struct bt_uuid *uuid) {

	params->uuid = uuid;
    params->func = discover_func; //i can change this
    params->start_handle = start;
    params->end_handle = end;
    params->type = type;

    int dis_err = bt_gatt_discover(default_conn, params);
    if (dis_err) {
        printk("Discovery type %u failed (err %d)\n", type, dis_err);
    }
}

static uint8_t discover_func(struct bt_conn *conn,
                             const struct bt_gatt_attr *attr,
                             struct bt_gatt_discover_params *params)
{
    if (!attr) {
        printk("Discovery complete\n");
        memset(params, 0, sizeof(*params));
        return BT_GATT_ITER_STOP;
    }

    struct bt_gatt_chrc *chrc;

    if (params->type == BT_GATT_DISCOVER_PRIMARY) {
        start_handle = attr->handle + 1;
        end_handle = ((struct bt_gatt_service_val *)attr->user_data)->end_handle;

        printk("Discovered service: start %u, end %u\n", start_handle, end_handle);

		//related to this
		run_discovery(&character_params,BT_GATT_DISCOVER_CHARACTERISTIC, start_handle, end_handle,NULL);

        return BT_GATT_ITER_CONTINUE;
    }

    if (params->type == BT_GATT_DISCOVER_CHARACTERISTIC) {

        chrc = (struct bt_gatt_chrc *)attr->user_data;

        if (!bt_uuid_cmp(chrc->uuid, &uuid_angle.uuid)) {

            angle_info.handle =  chrc->value_handle;
            angle_info.discovered = true;
            printk("Found angle characteristic at handle %u\n", angle_info.handle);
        } else if (!bt_uuid_cmp(chrc->uuid, &uuid_distance.uuid)) {

            distance_info.handle = chrc->value_handle;
            distance_info.discovered = true;
            printk("Found distance characteristic at handle %u\n", distance_info.handle);
        } else if (!bt_uuid_cmp(chrc->uuid, &uuid_power.uuid)) {

            power_info.handle = chrc->value_handle;
            power_info.discovered = true;
            printk("Found power_state characteristic at handle %u\n", power_info.handle);
            if(!settings_loaded) { //save it for power
                save_service_info(&power_info);
            }
        }

		if (angle_info.discovered && distance_info.discovered && power_info.discovered) {
            //printk("%d, %d, %d\r\n",power_info.handle, angle_info.handle, distance_info.handle);
			run_discovery(&descriptor_params,BT_GATT_DISCOVER_DESCRIPTOR, distance_info.handle + 1, end_handle, NULL);

            return BT_GATT_ITER_STOP;
		}

		return BT_GATT_ITER_CONTINUE;
    }

    if (params->type == BT_GATT_DISCOVER_DESCRIPTOR) {

        if (attr->handle == angle_info.handle + 1) {
            angle_info.ccc_handle = attr->handle;
            printk("Found CCC for angle at handle %u\n", angle_info.ccc_handle);
			generic_sub_start(conn,&angle_info);

        } else if (attr->handle == distance_info.handle + 1) {
            distance_info.ccc_handle = attr->handle;
            printk("Found CCC for distance at handle %u\n", distance_info.ccc_handle);
			generic_sub_start(conn,&distance_info);

        }
        return BT_GATT_ITER_CONTINUE;
    }

    return BT_GATT_ITER_CONTINUE;
}

static void connected(struct bt_conn *conn, uint8_t err)
{
    if (err) {
        printk("Connection failed (err %u)\n", err);
        return;
    }

    printk("Connected\n");
    default_conn = bt_conn_ref(conn);

    //just subcribe if already loaded all subcription settings
    if(settings_loaded) {
        generic_sub_start(default_conn,&angle_info);
        generic_sub_start(default_conn,&distance_info);
        return;
    }

	//run primary discovery if not loaded settings
	run_discovery(&discover_params,BT_GATT_DISCOVER_PRIMARY,BT_ATT_FIRST_ATTRIBUTE_HANDLE,
				  BT_ATT_LAST_ATTRIBUTE_HANDLE,&uuid_service.uuid);
}

static void disconnected(struct bt_conn *conn, uint8_t reason)
{
    printk("Disconnected (reason %u)\n", reason);
    if (default_conn) {
        bt_conn_unref(default_conn);
        default_conn = NULL;
    }

    //startup_scan();
}

BT_CONN_CB_DEFINE(conn_callbacks) = {
    .connected = connected,
    .disconnected = disconnected,
};

static bool eir_found(struct bt_data *data, void *user_data)
{
    bt_addr_le_t *orig_addr = user_data;

    if (data->type == BT_DATA_UUID128_ALL &&
        data->data_len == 16 &&
        !memcmp(data->data, uuid_service.val, 16)) {

        // Copy address before using it
        static bt_addr_le_t target_addr;
        bt_addr_le_copy(&target_addr, orig_addr);

        char addr_str[BT_ADDR_LE_STR_LEN];
        bt_addr_le_to_str(&target_addr, addr_str, sizeof(addr_str));
        printk("Connecting to %s\n", addr_str);

        const struct bt_le_conn_param *param = BT_LE_CONN_PARAM_DEFAULT;
        int err = bt_le_scan_stop();
        if (err) {
            printk("Stop LE scan failed (err %d)\n", err);
            return false;
        }

        err = bt_conn_le_create(&target_addr, BT_CONN_LE_CREATE_CONN, param, &default_conn);
        if (err) {
            printk("Create connection failed (err %d)\n", err);
            return false;
        }

        return false; // stop parsing
    }

    return true;
}

// static bool eir_found(struct bt_data *data, void *user_data)
// {
//     bt_addr_le_t *addr = user_data;
//     //int i;

//     if (data->type == BT_DATA_UUID128_ALL &&
//         data->data_len == 16 &&
//         !memcmp(data->data, uuid_service.val, 16)) {

//         struct bt_le_conn_param *param = BT_LE_CONN_PARAM_DEFAULT;
//         int err = bt_le_scan_stop();
//         if (err) {
//             printk("Stop LE scan failed (err %d)\n", err);
//             return false;
//         }

//         err = bt_conn_le_create(addr, BT_CONN_LE_CREATE_CONN, param, &default_conn);
//         if (err) {
//             printk("Create connection failed (err %d)\n", err);
//             return false;
//         }

//         return false; // stop parsing
//     }

//     return true;
// }

static void device_found(const bt_addr_le_t *addr, int8_t rssi, uint8_t type,
                         struct net_buf_simple *ad)
{
     if (type == BT_GAP_ADV_TYPE_ADV_IND || type == BT_GAP_ADV_TYPE_ADV_DIRECT_IND) {
        bt_data_parse(ad, eir_found, (void *)addr);
    }
}

uint8_t startup_scan(void) {
    int err = bt_le_scan_start(BT_LE_SCAN_ACTIVE, device_found);
    if (err) {
        printk("Scanning failed to start (err %d)\n", err);
        return 1;
    }
    return 0;
}
```

## src/sub_settings.c
```c
#include <zephyr/sys/printk.h>
#include <string.h>
#include <zephyr/settings/settings.h>
#include "gatt_client.h"
#include "sub_settings.h"

//accessed by this once before bluetooth, no mutex necesseary
volatile bool settings_loaded = false;

int save_service_info(volatile struct service_info* info) {

    char key[27] = "subs/";
    //create the key myself
    strncpy(&key[5], (char *)info->name, 22);

    struct service_info_store tmp = {
        .handle = info->handle,
        .ccc_handle = info->ccc_handle,
        .subscribed = info->subscribed //have to fix
    };
    printk("saved to %s\r\n",key);
    return settings_save_one(key, &tmp, sizeof(tmp));
}

//load callback for each variable
static int settings_handler_cb(const char *key, size_t len, settings_read_cb read_cb,
                               void *cb_arg) {
    struct service_info *info;

    if (strcmp(key, "angle") == 0) {
        info = &angle_info;
    } else if (strcmp(key, "distance") == 0) {
        info = &distance_info;
    } else if (strcmp(key, "power") == 0) {
        info = &power_info;
    } else {
        printk("failed to read data\r\n");
        return -ENOENT;
    }

    struct service_info_store tmp;

    ssize_t ret = read_cb(cb_arg, &tmp, sizeof(tmp));
    if (ret <= 0) {
        printk("failed to read data here\r\n");
        return -EIO;
    }

    printk("handle: %d\r\n",tmp.handle);
    info->handle = tmp.handle;
    info->ccc_handle = tmp.ccc_handle;
    //info->subscribed = tmp.subscribed; //leave it false for subcriptions
    info->discovered = true;

    return 0;
}


void settings_load_subs(void) {
    int err;

    err = settings_subsys_init();
    if (err) {
        printk("Settings subsystem init failed (err %d)\n", err);
        return;
    }

    static struct settings_handler subs_handler = {
    .name = SETTINGS_SUB_PATH,
    .h_set = settings_handler_cb,
    };

    err = settings_register(&subs_handler);
    if (err) {
        printk("Settings handler register failed (err %d)\n", err);
        return;
    }

    err = settings_load_subtree(SETTINGS_SUB_PATH);
    if (err) {
        printk("Failed to load subscriptions settings (err %d)\n", err);
        settings_loaded = false;
    } else {
        printk("Subscriptions loaded from settings\n");
        settings_loaded = true;
    }
}
```
